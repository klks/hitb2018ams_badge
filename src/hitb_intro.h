#include "hitb_leds.h"
extern Adafruit_SSD1306 display;
extern int button_cancel_state;

static const unsigned char PROGMEM hitb_glcd_bmp[] = {
0x00, 0x00, 0x00, 0x01, 0x00, 0x00, 0x00, 0x00, 0x00, 0x00, 0x00, 0x07, 0xC0, 0x00, 0x00, 0x00,
0x00, 0x00, 0x00, 0x0F, 0xE0, 0x00, 0x00, 0x00, 0x00, 0x00, 0x00, 0x39, 0xB8, 0x00, 0x00, 0x00,
0x00, 0x00, 0x00, 0xE1, 0x9E, 0x00, 0x00, 0x00, 0x00, 0x00, 0x03, 0x81, 0x87, 0x80, 0x00, 0x00,
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0x00, 0x00, 0x00, 0x07, 0xC0, 0x00, 0x00, 0x00, 0x00, 0x00, 0x00, 0x01, 0x00, 0x00, 0x00, 0x00
};

void hitb_intro(){
  //strip.setBrightness(10);
  strip.show();
  display.clearDisplay();
  char hitb2018ams[] = "HITB2018AMS";
  char hitb[] = "HITB 2018";
  char ams[] = "Amsterdam";
  char only_hitb[] = "HITB";
  char only_2018[] = "2018";
  int i;

  display.setTextColor(WHITE);
  display.setTextSize(2);
        
  long r = random(4);
  //r = 4;
  int loop_len = 0;
  
  switch(r){
    case 0: //HITB 2018 U->D, AMS D->U 
      loop_len = 33;
      for(i=0; i<33; i++){
        display.clearDisplay();
        display.setCursor(15, i - 15 );
        display.print(hitb);
        display.setCursor(13, (loop_len+33) - i);
        display.print(ams);
        display.display();
        rainbowCycle(20, i);
      }
      break;
    case 1: //HITB 2018 D->U, AMS U->D
      loop_len = 70;
      for(i=0; i<loop_len; i++){
        display.clearDisplay();
        display.setCursor(15, (loop_len+15) - i);
        display.print(hitb);
        display.setCursor(13, (33-loop_len) + i);
        display.print(ams);
        display.display();
        rainbowCycle(20, i);
      }
      break;
    case 2: //HITB 2018 L->R, AMS R->L
      loop_len = 130;
      for(i=0; i<loop_len; i++){
        display.clearDisplay();
        display.setCursor( (15+loop_len) - i, 15);
        display.print(hitb);
        display.setCursor( (13-loop_len) + i , 33);
        display.print(ams);
        display.display();
        rainbowCycle(10, i);
      }
      break;
    case 3: //HITB L->R, 2018 R->L, AMS D->U
      loop_len = 33;
      for(i=0; i<loop_len; i++){
        display.clearDisplay();
        display.setCursor( (15-loop_len) + i, 15);
        display.println(only_hitb);
        display.setCursor( (75+loop_len) - i, 15);
        display.print(only_2018);
        display.setCursor(13, (loop_len+33) - i);
        display.print(ams);
        display.display();
        rainbowCycle(20, i);
      }
      break; 
    default:
      display.clearDisplay();
      display.setCursor(15, 15);
      display.println(only_hitb);
      display.setCursor(75, 15);
      display.println(only_2018);
      display.setCursor(13, 33);
      display.println(ams);
      display.display();
      break;
    }

    //Wait 1500ms
    for(int i=0; i<150; i++){
       rainbowCycle(10, i);
    }

    //Queue in logo
    display.clearDisplay();
    display.drawBitmap(32, 0, hitb_glcd_bmp, 64, 64, WHITE);
    display.display();

    //Wait 2000ms
    for(int i=0; i<200; i++){
       rainbowCycle(10, i);
    }
    
    display.clearDisplay();
    display.display();
    leds_off();
}

//Taken from https://github.com/mikerr/arduino-oled/blob/master/starfield.ino
#define STARS 75
#define DISPLAY_WIDTH 128
#define DISPLAY_HEIGHT 64

float star_x[STARS], star_y[STARS], star_z[STARS];

void initStar(int i) {
  star_x[i] = random(-100, 100);
  star_y[i] = random(-100, 100);
  star_z[i] = random(100, 500);
}

void about_starfiled(){
  display.clearDisplay();
  display.setTextSize(1);
  display.setTextColor(WHITE);
      
  for (int i = 0; i < STARS; i++) 
    initStar(i);

  strip.setBrightness(50);
  while(intro_random()){
    display.clearDisplay();
    int x,y;
    int centrex,centrey;
    
    centrex = DISPLAY_WIDTH / 2;
    centrey = DISPLAY_HEIGHT / 2; 
    
    for (int i = 0; i < STARS; i++) {
      star_z[i] = star_z[i] - 7;
  
      x = star_x[i] / star_z[i] * 100 + centrex;
      y = star_y[i] / star_z[i] * 100 + centrey;
  
      if(
          (x < 0)  ||        (x > DISPLAY_WIDTH) || 
          (y < 0)  ||        (y > DISPLAY_HEIGHT) ||
          (star_z[i] < 1)      
        )      initStar(i);
      display.drawPixel(x, y, WHITE);
    }
    display.setCursor(5,20);
    display.print("Design : WhiteA10n3");
    display.setCursor(13,30);
    display.print("Coding : xwings");
    display.setCursor(15,40);
    display.print("Coding : KLKS");
    display.display();
  }
  leds_off();
  strip.setBrightness(100);
}

